## boards/arm/tekdaqc_e/Kconfig.board
```kconfig
# TekDAQC Rev E board configuration

config BOARD_TEKDAQC_E
	bool "TekDAQC Rev E Data Acquisition Board"
	depends on SOC_STM32F407XG
```

## boards/arm/tekdaqc_e/Kconfig.defconfig
```kconfig
# TekDAQC Rev E board configuration

# Copyright (c) 2016 Linaro Limited.
# SPDX-License-Identifier: Apache-2.0

if BOARD_TEKDAQC_E

config BOARD
	default "tekdaqc_e"

endif # BOARD_TEKDAQC_E
```

## boards/arm/tekdaqc_e/tekdaqc_e_defconfig
```kconfig
# SPDX-License-Identifier: Apache-2.0
CONFIG_BOARD_TEKDAQC_E=y

# SOC
CONFIG_SOC_SERIES_STM32F4X=y
CONFIG_SOC_STM32F407XG=y

# 168MHz system clock
CONFIG_SYS_CLOCK_HW_CYCLES_PER_SEC=168000000
CONFIG_CLOCK_STM32_HSE_CLOCK=8000000
CONFIG_CLOCK_STM32_SYSCLK_SRC_PLL=y
CONFIG_CLOCK_STM32_PLL_SRC_HSE=y
CONFIG_CLOCK_STM32_PLL_M_DIVISOR=8
CONFIG_CLOCK_STM32_PLL_N_MULTIPLIER=336
CONFIG_CLOCK_STM32_PLL_P_DIVISOR=2
CONFIG_CLOCK_STM32_PLL_Q_DIVISOR=7
CONFIG_CLOCK_STM32_AHB_PRESCALER=1
CONFIG_CLOCK_STM32_APB1_PRESCALER=4
CONFIG_CLOCK_STM32_APB2_PRESCALER=2

# Enable MPU
#CONFIG_ARM_MPU=y

# Enable HW stack protection
#CONFIG_HW_STACK_PROTECTION=y

# serial port
CONFIG_SERIAL=y
#CONFIG_UART_STM32=y

# enable GPIO
CONFIG_GPIO=y
CONFIG_PINMUX=y

# Entropy
CONFIG_ENTROPY_GENERATOR=y
CONFIG_ENTROPY_DEVICE_RANDOM_GENERATOR=y
CONFIG_HARDWARE_DEVICE_CS_GENERATOR=y
```

## modules/tekdaqc/drivers/adc/ads1256/Kconfig
```kconfig
# ADS125x ADC configuration options

config ADC_ADS125X
	bool "ADS1255/ADS1256 driver"
	depends on SPI
	help
	  Enable ADS1255/ADS1256 ADC driver.

	  The AdS1255/ADS1256 are 2/8 channel 24-bit Sigma-Delta A/D converters
	  with SPI interface.

if ADC_ADS125X

config ADC_ADS125X_INIT_PRIORITY
	int "Init priority"
	default 80
	help
	  ADC_ADS125X ADC device driver initialization priority.

config ADC_ADS125X_ACQUISITION_THREAD_STACK_SIZE
	int "Stack size for the ADC data acquisition thread"
	default 512
	help
	  Size of the stack used for the internal data acquisition
	  thread.

config ADC_ADC_ADS125X_ACQUISITION_THREAD_PRIO
	int "Priority for the ADC data acquisition thread"
	default 0
	help
	  Priority level for the internal ADC data acquisition thread.

endif # ADC_ADS125X
```
